## conf/layer.conf
```bitbake
# We have a conf and classes directory, append to BBPATH
BBPATH .= ":${LAYERDIR}"

# We have a recipes directory, add to BBFILES
BBFILES += "${LAYERDIR}/recipes-*/*.bb ${LAYERDIR}/recipes-*/*.bbappend \
            ${LAYERDIR}/recipes-*/*/*.bb ${LAYERDIR}/recipes-*/*/*.bbappend \
            ${LAYERDIR}/recipes-*/*/*/*.bb ${LAYERDIR}/recipes-*/*/*/*.bbappend"

LAYERSERIES_COMPAT_meta-sh4-layer = "warrior"

# Additional license directories.
LICENSE_PATH += "${LAYERDIR}/conf/license"

META-sh4-BASE := '${@os.path.normpath("${LAYERDIR}/../")}'
META-sh4-BASE[vardepvalue] = 'meta-sh4'

WAF_CROSS_ANSWERS_PATH_sh4 = "${LAYERDIR}/files/waf-cross-answers"

DEBUG_PREFIX_MAP = "-fdebug-prefix-map=${WORKDIR}=/usr/src/debug/${PN}/${EXTENDPE}${PV}-${PR} \
                     -fdebug-prefix-map=${STAGING_DIR_HOST}= \
                     -fdebug-prefix-map=${STAGING_DIR_NATIVE}= \
"
DEBUG_FLAGS = "-g -feliminate-unused-debug-types ${DEBUG_PREFIX_MAP}"
```

## conf/machine/adb_2850.conf
```bitbake
require conf/machine/include/nbox.inc

PREFERRED_PROVIDER_virtual/kernel = "linux-sh4-adb2850"

MACHINE_FEATURES += "adb_2850"

AUDIOELF = "audio_7111.elf"
VIDEOELF = "video_7111.elf"

SOC_FAMILY = "sti7111"

MACHINE_ESSENTIAL_EXTRA_RDEPENDS += "\
    stlinux24-sh4-stx7111-fdma-firmware \
    stlinux24-sh4-stmfb-firmware-stx7111 \
"
```

## conf/machine/adb_box.conf
```bitbake
require conf/machine/include/nbox.inc

MACHINE_FEATURES += "SCART fan"

AUDIOELF = "audio_7100.elf"
VIDEOELF = "video_7100.elf"

SOC_FAMILY = "sti7100"

MACHINE_ESSENTIAL_EXTRA_RDEPENDS += "\
	fp-control \
	stlinux24-sh4-stx7100-fdma-firmware \
	"

STXNUMBER = "stx7100"
```

## conf/machine/arivalink200.conf
```bitbake
require conf/machine/include/oem-sh4.inc
require conf/machine/include/normal-sh4-image.inc

BOX_BRAND = "ferguson"

PREFERRED_PROVIDER_virtual/kernel = "linux-sh4-${BOX_BRAND}"

ROOTFS_FILE = "root.img"
KERNEL_FILE = "uImage"

IMAGE_FSTYPES += "tar.gz"

MACHINE_FEATURES += "hdmicec ci smallflash modutils-sh4 arivalink200"

AUDIOELF = "audio_7100.elf"
VIDEOELF = "video_7109.elf"

SOC_FAMILY = "sti7109"

DVB1FIRMWARE = "dvb-fe-avl6222.fw"
DVB2FIRMWARE = "dvb-fe-cx24116.fw"

MACHINE_ESSENTIAL_EXTRA_RDEPENDS += "\
    stlirc \
    evremote2 \
    stlinux24-sh4-stx7109-fdma-firmware \
    firmware-sh4 \
"

CAN_USE_ENIGMA2_IN_FLASH = "1"
```

## conf/machine/atevio7500.conf
```bitbake
require conf/machine/include/oem-sh4.inc
require conf/machine/include/ird-sh4-image.inc
require conf/machine/include/sh4-jffs2.inc

BOX_BRAND = "atevio"

MTD_KERNEL = "mtd4"
MTD_ROOTFS = "mtd5"

PREFERRED_PROVIDER_virtual/kernel = "linux-sh4-${BOX_BRAND}"

ROOTFS_FILE = "root.img"
KERNEL_FILE = "uImage"

IMAGE_FSTYPES = "tar.gz"

MACHINE_FEATURES += "ci twintuner hdmicec smallflash modutils-sh4 atevio7500"

AUDIOELF = "audio_7105.elf"
VIDEOELF = "video_7105.elf"

SOC_FAMILY = "sti7105"

DVB1FIRMWARE = "dvb-fe-avl2108.fw"
DVB2FIRMWARE = "dvb-fe-stv6306.fw"

MACHINE_ESSENTIAL_EXTRA_RDEPENDS += "\
    stlinux24-sh4-stx7105-fdma-firmware \
    stlinux24-sh4-stmfb-firmware-stx7105 \
    firmware-sh4 \
    evremote2 \
    enigma2-plugin-extensions-hs8200vfd \
"

CAN_USE_ENIGMA2_IN_FLASH = "1"

RESELLERID = "23190000"
#RESELLERID = "231900A0"
```

## conf/machine/cuberevo.conf
```bitbake
require conf/machine/include/cuberevo.inc

MACHINE_FEATURES += "twintuner RCA YUV SVIDEO"
```

## conf/machine/cuberevo9500hd.conf
```bitbake
require conf/machine/include/oem-fulan.inc
require conf/machine/include/cuberevo.inc

MACHINE_FEATURES += "twintuner ci"
```

## conf/machine/cuberevo_2000hd.conf
```bitbake
require conf/machine/include/cuberevo.inc

MACHINE_FEATURES += "cuberevo_2000hd"
```

## conf/machine/cuberevo_3000hd.conf
```bitbake
require conf/machine/include/cuberevo.inc

MACHINE_FEATURES += "cuberevo_3000hd"
```

## conf/machine/cuberevo_9500hd.conf
```bitbake
require conf/machine/include/cuberevo.inc

MACHINE_FEATURES += "twintuner cuberevo_9500hd"
```

## conf/machine/cuberevo_mini.conf
```bitbake
require conf/machine/include/cuberevo.inc

MACHINE_FEATURES += "RCA YUV"

RCTYPE = "22"
RCNAME = "cuberevo"
```

## conf/machine/forever_2424hd.conf
```bitbake
require conf/machine/include/forever.inc

MTD_KERNEL = "mtd1"
MTD_ROOTFS = "mtd2"

MACHINE_FEATURES += "forever_2424hd ci 7segment"
```

## conf/machine/forever_3434hd.conf
```bitbake
require conf/machine/include/forever.inc

MACHINE_FEATURES += "RCA"

RESELLERID = "29090300"

FRIENDLY_FAMILY = "dp7050"
```

## conf/machine/forever_9898hd.conf
```bitbake
require conf/machine/include/forever.inc

MACHINE_FEATURES += "forever_9898hd ci textlcd"

RESELLERID = "29090200"
```

## conf/machine/forever_nanosmart.conf
```bitbake
require conf/machine/include/forever.inc

MTD_KERNEL = "mtd1"
MTD_ROOTFS = "mtd2"

MACHINE_FEATURES += "forever_nanosmart ci 7segment"

RESELLERID = "29090000"
```

## conf/machine/fortis_hdbox.conf
```bitbake
require conf/machine/include/oem-sh4.inc
require conf/machine/include/normal-sh4-image.inc
require conf/machine/include/sh4-jffs2.inc

BOX_BRAND = "fortis"

STXNUMBER = "stx7109"

ROOTFS_FILE = "root.img"
KERNEL_FILE = "uImage"

IMAGE_FSTYPES = "tar.gz"

MACHINE_FEATURES += "ci SCART RCA YUV resellerid"

AUDIOELF = "audio_7100.elf"
VIDEOELF = "video_7109.elf"

SOC_FAMILY = "sti7109"

MACHINE_ESSENTIAL_EXTRA_RDEPENDS += "\
	fp-control \
	kernel-module-zram \
	stlinux24-sh4-stx7109-fdma-firmware \
	"

CAN_USE_ENIGMA2_IN_FLASH = "0"

RESELLERID = "20020000"

RCTYPE = "7"
RCNAME = "fs9000"

FRIENDLY_FAMILY = "fs9000"
```

## conf/machine/hl101.conf
```bitbake
require conf/machine/include/oem-sh4.inc
require conf/machine/include/normal-sh4-image.inc

BOX_BRAND = "spiderbox"

PREFERRED_PROVIDER_virtual/kernel = "linux-sh4-${BOX_BRAND}"

IMAGE_FSTYPES = "tar.gz"

AUDIOELF = "audio_7100.elf"
VIDEOELF = "video_7109.elf"

SOC_FAMILY = "sti7109"

DVB1FIRMWARE = "dvb-fe-avl2108.fw"
DVB2FIRMWARE = "dvb-fe-stv6306.fw"

MACHINE_ESSENTIAL_EXTRA_RDEPENDS += "\
    stlirc \
    firmware-sh4 \
    stlinux24-sh4-stx7109-fdma-firmware \
"

MACHINE_FEATURES += "ci hl101 textlcd middleflash"

CAN_USE_ENIGMA2_IN_FLASH = "1"
```

## conf/machine/hs7110.conf
```bitbake
require conf/machine/include/hs.inc
require conf/machine/include/normal-sh4-image.inc

MTD_KERNEL = "mtd2"
MTD_ROOTFS = "mtd3"

MACHINE_FEATURES += "smallflash hs7110"

MACHINE_ESSENTIAL_EXTRA_RDEPENDS += "\
	enigma2-plugin-extensions-hs7110vfd \
	"

CAN_USE_ENIGMA2_IN_FLASH = "0"

RESELLERID = "250202A0"
```

## conf/machine/hs7119.conf
```bitbake
require conf/machine/include/hs.inc
require conf/machine/include/ird-ubi-image.inc

MTD_KERNEL = "mtd1"
MTD_ROOTFS = "mtd2"

CAN_USE_ENIGMA2_IN_FLASH = "1"

RESELLERID = "271500A0"

RCTYPE = "9"
RCNAME = "hs7110"
```

## conf/machine/hs7420.conf
```bitbake
require conf/machine/include/hs.inc
require conf/machine/include/normal-sh4-image.inc
require conf/machine/include/sh4-ubi.inc

MTD_KERNEL = "mtd2"
MTD_ROOTFS = "mtd3"

MACHINE_FEATURES += "smallflash SCART RCA YUV"

CAN_USE_ENIGMA2_IN_FLASH = "0"

RESELLERID = "25070300"
#RESELLERID = "250703A0"

RCTYPE = "8"
```

## conf/machine/hs7429.conf
```bitbake
require conf/machine/include/hs.inc
require conf/machine/include/ird-sh4-image.inc
require conf/machine/include/sh4-ubi.inc

MTD_KERNEL = "mtd1"
MTD_ROOTFS = "mtd2"

MACHINE_FEATURES += "hs7429"

CAN_USE_ENIGMA2_IN_FLASH = "1"

RESELLERID = "270130A0"

MACHINE_ESSENTIAL_EXTRA_RDEPENDS += "\
    flash-tools \
"
```
