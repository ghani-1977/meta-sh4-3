## conf/machine/pace7241.conf
```bitbake
require conf/machine/include/oem-sh4.inc

BOX_BRAND = "pace"

PREFERRED_PROVIDER_virtual/kernel = "linux-sh4-${BOX_BRAND}"

ROOTFS_FILE = "root.img"
KERNEL_FILE = "uImage"

IMAGE_FSTYPES += "tar.gz"

MACHINE_FEATURES += "hdmicec fan ci smallflash modutils-sh4 pace7241"

AUDIOELF = "audio_7105.elf"
VIDEOELF = "video_7105.elf"

SOC_FAMILY = "sti7105"

MACHINE_ESSENTIAL_EXTRA_RDEPENDS += "\
    stlinux24-sh4-stx7105-fdma-firmware \
    stlinux24-sh4-stmfb-firmware-stx7105 \
    firmware-sh4 \
    stlirc \
"

CAN_USE_ENIGMA2_IN_FLASH = "1"
```

## conf/machine/sagemcom88.conf
```bitbake
require conf/machine/include/oem-sh4.inc
require conf/machine/include/normal-sh4-image.inc
require conf/machine/include/sh4-jffs2.inc

BOX_BRAND = "sagemcom"

PREFERRED_PROVIDER_virtual/kernel = "linux-sh4-${BOX_BRAND}"

ROOTFS_FILE = "root.img"
KERNEL_FILE = "uImage"

IMAGE_FSTYPES += "tar.gz"

MACHINE_FEATURES += "hdmicec ci smallflash modutils-sh4 sagemcom88"

AUDIOELF = "audio_7105.elf"
VIDEOELF = "video_7105.elf"

SOC_FAMILY = "sti7105"

MACHINE_ESSENTIAL_EXTRA_RDEPENDS += "\
	stlirc \
	stlinux24-sh4-stx7105-fdma-firmware \
	stlinux24-sh4-stmfb-firmware-stx7105 \
	firmware-sh4 \
	evremote2 \
	"

CAN_USE_ENIGMA2_IN_FLASH = "1"
```

## conf/machine/sf1008.conf
```bitbake
require conf/machine/include/oem-fulan.inc

MACHINE_FEATURES += "ci"

SOC_FAMILY = "sti7109"

MACHINE_ESSENTIAL_EXTRA_RDEPENDS += "\
    stlinux24-sh4-stx7109-fdma-firmware \
	firmware-sh4-fulan \
"

#What we need
#$(SILENT)cp $(TARGET_DIR)/lib/modules/$(KERNEL_VER)/extra/frontcontroller/nuvoton/nuvoton.ko $(RELEASE_DIR)/lib/modules/
#$(SILENT)cp $(TARGET_DIR)/lib/modules/$(KERNEL_VER)/extra/frontends/*.ko $(RELEASE_DIR)/lib/modules/
#$(SILENT)cp $(TARGET_DIR)/lib/modules/$(KERNEL_VER)/extra/stgfb/stmfb/stmcore-display-stx7109c3.ko $(RELEASE_DIR)/lib/modules/
#$(SILENT)cp -f $(SKEL_ROOT)/root_enigma2/usr/local/share/enigma2/keymap_fortis.xml $(RELEASE_DIR)/usr/local/share/enigma2/keymap.xml
```

## conf/machine/spark.conf
```bitbake
require conf/machine/include/oem-fulan.inc
require conf/machine/include/spark.inc

SOC_FAMILY = "sti7111"

MACHINE_ESSENTIAL_EXTRA_RDEPENDS += "\
	stlinux24-sh4-stx7111-fdma-firmware \
	stlinux24-sh4-stmfb-firmware-stx7111 \
"

MACHINE_FEATURES += "spark"
```

## conf/machine/spark7162.conf
```bitbake
require conf/machine/include/spark.inc

AUDIOELF = "audio_7105.elf"
VIDEOELF = "video_7105.elf"

SOC_FAMILY = "sti7105"

MACHINE_ESSENTIAL_EXTRA_RDEPENDS += "\
	stlinux24-sh4-stmfb-firmware-stx7105 \
	stlinux24-sh4-stx7105-fdma-firmware \
	vfdctl \
	"

FRIENDLY_FAMILY = "amikoalien sognotriple sparktriplex sabtriple giavatar sparkone dynaspark7162"
```

## conf/machine/tf7700.conf
```bitbake
require conf/machine/include/oem-sh4.inc
require conf/machine/include/normal-sh4-image.inc
require conf/machine/include/sh4-jffs2.inc

BOX_BRAND = "topfield"

PREFERRED_PROVIDER_virtual/kernel = "linux-sh4-${BOX_BRAND}"

ROOTFS_FILE = "root.img"
KERNEL_FILE = "uImage"

IMAGE_FSTYPES += "tar.gz"

MACHINE_FEATURES += "twintuner modutils-sh4 RCA YUV SCART"

AUDIOELF = "audio_7100.elf"
VIDEOELF = "video_7109.elf"

SOC_FAMILY = "sti7109"

MACHINE_ESSENTIAL_EXTRA_RDEPENDS += "\
	stlinux24-sh4-stx7109-fdma-firmware \
	firmware-sh4 \
	evremote2 \
	enigma2-plugin-extensions-topfieldvfd \
	fp-control \
	tfd2mtd \
	tffpctl \
	"

CAN_USE_ENIGMA2_IN_FLASH = "1"

RCTYPE = "11"

RCNAME = "tf7700"
```

## conf/machine/ufc960.conf
```bitbake
require conf/machine/include/kathrein.inc

MTD_KERNEL = "mtd1"
MTD_ROOTFS = "mtd2"

MACHINE_FEATURES += "ci smallflash ufc960"

AUDIOELF = "audio_7100.elf"
VIDEOELF = "video_7109.elf"

SOC_FAMILY = "sti7109"

DVB1FIRMWARE = "dvb-fe-cx21143.fw"
DVB2FIRMWARE = "dvb-fe-stv6306.fw"

MACHINE_ESSENTIAL_EXTRA_RDEPENDS += "\
    stlinux24-sh4-stx7109-fdma-firmware \
    firmware-sh4 \
"

CAN_USE_ENIGMA2_IN_FLASH = "1"
```

## conf/machine/ufs910.conf
```bitbake
require conf/machine/include/kathrein.inc

MACHINE_FEATURES += "smallflash"

AUDIOELF = "audio_7100.elf"
VIDEOELF = "video_7100.elf"

SOC_FAMILY = "sti7100"

MACHINE_ESSENTIAL_EXTRA_RDEPENDS += "\
	firmware-sh4 \
	stlinux24-sh4-stx7100-fdma-firmware \
	stlirc \
	vfdctl \
	"

CAN_USE_ENIGMA2_IN_FLASH = "0"
# It's possible to flash 16MB images which is not even our smallflash = 64MB

RCTYPE = "19"
RCNAME = "ufs910"
```

## conf/machine/ufs912.conf
```bitbake
require conf/machine/include/kathrein.inc

MACHINE_FEATURES += "hdmicec"

AUDIOELF = "audio_7111.elf"
VIDEOELF = "video_7111.elf"

SOC_FAMILY = "sti7111"

MACHINE_ESSENTIAL_EXTRA_RDEPENDS += "\
	stlinux24-sh4-stx7111-fdma-firmware \
	stlinux24-sh4-stmfb-firmware-stx7111 \
	vfdctl \
	"

CAN_USE_ENIGMA2_IN_FLASH = "1"

RCTYPE = "12"
```

## conf/machine/ufs913.conf
```bitbake
require conf/machine/include/kathrein.inc

MTD_KERNEL = "mtd8"
MTD_ROOTFS = "mtd9"

MACHINE_FEATURES += "hdmicec twintuner smallflash"

AUDIOELF = "audio_7105.elf"
VIDEOELF = "video_7105.elf"

SOC_FAMILY = "sti7105"

MACHINE_ESSENTIAL_EXTRA_RDEPENDS += "\
	stlinux24-sh4-stx7105-fdma-firmware \
	stlinux24-sh4-stmfb-firmware-stx7105 \
	firmware-sh4 \
	vfdctl \
	"

CAN_USE_ENIGMA2_IN_FLASH = "1"
```

## conf/machine/ufs922.conf
```bitbake
require conf/machine/include/kathrein.inc

MACHINE_FEATURES += "fan nofhdskin"

AUDIOELF = "audio_7100.elf"
VIDEOELF = "video_7109.elf"

SOC_FAMILY = "sti7109"

MACHINE_ESSENTIAL_EXTRA_RDEPENDS += "\
	eeprom-${MACHINE} \
	firmware-sh4 \
	stlinux24-sh4-stx7109-fdma-firmware \
	"

CAN_USE_ENIGMA2_IN_FLASH = "0"

RCTYPE = "19"
RCNAME = "ufs912"

STXNUMBER = "stx7109"
```

## conf/machine/vip2_v1.conf
```bitbake
require conf/machine/include/edisionargus.inc

MACHINE_FEATURES += "twintuner vip2_v1"
```

## conf/machine/vitamin_hd5000.conf
```bitbake
require conf/machine/include/oem-sh4.inc
require conf/machine/include/smallflash.inc
require conf/machine/include/modsh4.inc

PREFERRED_PROVIDER_virtual/kernel = "linux-sh4-vitaminhd5000"

ROOTFS_FILE = "root.img"
KERNEL_FILE = "uImage"

IMAGE_FSTYPES += "tar.gz"

MACHINE_FEATURES += "hdmicec ci vitamin_hd5000"

AUDIOELF = "audio_7111.elf"
VIDEOELF = "video_7111.elf"

SOC_FAMILY = "sti7111"

MACHINE_ESSENTIAL_EXTRA_RDEPENDS += "\
    stlinux24-sh4-stx7111-fdma-firmware \
    stlinux24-sh4-stmfb-firmware-stx7111 \
    evremote2 \
"
```
