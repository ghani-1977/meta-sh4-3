## conf/machine/hs7810a.conf
```bitbake
require conf/machine/include/hs.inc
require conf/machine/include/normal-sh4-image.inc
require conf/machine/include/sh4-jffs2.inc

MTD_KERNEL = "mtd2"
MTD_ROOTFS = "mtd3"

MACHINE_FEATURES += "smallflash hs7810a"

CAN_USE_ENIGMA2_IN_FLASH = "0"

RESELLERID = "25070000"
#RESELLERID = "250700A0"
```

## conf/machine/hs7819.conf
```bitbake
require conf/machine/include/hs.inc
require conf/machine/include/ird-ubi-image.inc

MTD_KERNEL = "mtd1"
MTD_ROOTFS = "mtd2"

MACHINE_FEATURES += "SCART RCA"

CAN_USE_ENIGMA2_IN_FLASH = "1"

RESELLERID = "271520A0"

RCTYPE = "8"
```

## conf/machine/include/atemio.inc
```bitbake
require conf/machine/include/oem-fulan.inc
require conf/machine/include/smallflash.inc
require conf/machine/include/modsh4.inc

PREFERRED_PROVIDER_virtual/kernel = "linux-fulan-atemio"

ROOTFS_FILE = "root.img"
KERNEL_FILE = "uImage"

IMAGE_FSTYPES += "tar.gz"

AUDIOELF = "audio_7111.elf"
VIDEOELF = "video_7111.elf"

STLIRCFILE = "atemio"

SOC_FAMILY = "sti7111"

MACHINE_ESSENTIAL_EXTRA_RDEPENDS += "\
    stlinux24-sh4-stx7111-fdma-firmware \
    stlinux24-sh4-stmfb-firmware-stx7111 \
    evremote2 \
"
```

## conf/machine/include/crenova.inc
```bitbake
require conf/machine/include/oem-sh4.inc
require conf/machine/include/normal-sh4-image.inc
require conf/machine/include/sh4-jffs2.inc

BOX_BRAND = "opticum"

ROOTFS_FILE = "root.img"
KERNEL_FILE = "uImage"

IMAGE_FSTYPES = "tar.gz"

MACHINE_ESSENTIAL_EXTRA_RDEPENDS += "\
	fp-control \
	"

MACHINE_FEATURES += "ci RCA"

CAN_USE_ENIGMA2_IN_FLASH = "1"

RCTYPE = "21"
RCNAME = "opt9600"
```

## conf/machine/include/cuberevo.inc
```bitbake
require conf/machine/include/oem-sh4.inc
require conf/machine/include/normal-sh4-image.inc

BOX_BRAND = "cuberevo"

MTD_KERNEL = "mtd3"
MTD_ROOTFS = "mtd4"

PREFERRED_PROVIDER_virtual/kernel = "linux-sh4-${BOX_BRAND}"

IMAGE_FSTYPES = "tar.gz"

AUDIOELF = "audio_7100.elf"
VIDEOELF = "video_7109.elf"

SOC_FAMILY = "sti7109"

DVB1FIRMWARE = "dvb-fe-cx24116.fw"
DVB2FIRMWARE = "dvb-fe-stv6306.fw"

MACHINE_ESSENTIAL_EXTRA_RDEPENDS += "\
	stlinux24-sh4-stx7109-fdma-firmware \
	firmware-sh4 \
	evremote2 \
	enigma2-plugin-extensions-cuberevovfd \
	ipbox-eeprom \
	fp-control \
	"

MACHINE_FEATURES += "ci middleflash SCART"

EXTRA_OECONF_append_pn-enigma2 += " --with-cuberevostb"

CAN_USE_ENIGMA2_IN_FLASH = "0"

RCTYPE = "13"
```

## conf/machine/include/edisionargus.inc
```bitbake
require conf/machine/include/oem-sh4.inc
require conf/machine/include/wifi-sh4.inc
require conf/machine/include/normal-sh4-image.inc

BOX_BRAND = "edisionargus"

PREFERRED_PROVIDER_virtual/kernel = "linux-sh4-${BOX_BRAND}"

IMAGE_FSTYPES += "tar.gz"

MACHINE_EXTRA_RRECOMMENDS += "\
    ntfs-3g \
"

AUDIOELF = "audio_7100.elf"
VIDEOELF = "video_7109.elf"

SOC_FAMILY = "sti7109"

MACHINE_ESSENTIAL_EXTRA_RDEPENDS += "\
    stlirc \
    evremote2 \
    stlinux24-sh4-stx7109-fdma-firmware \
"

MACHINE_FEATURES += "ci directfb"

DISTRO_FEATURES_append += "gtk-directfb"

CAN_USE_ENIGMA2_IN_FLASH = "1"
```

## conf/machine/include/forever.inc
```bitbake
require conf/machine/include/oem-sh4.inc
require conf/machine/include/ird-sh4-image.inc
require conf/machine/include/sh4-ubi.inc

BOX_BRAND = "forever"

PREFERRED_PROVIDER_virtual/kernel = "linux-sh4-${BOX_BRAND}"

ROOTFS_FILE = "root.img"

IMAGE_FSTYPES += "tar.gz"

AUDIOELF = "companion_h205_audio.bin"
VIDEOELF = "companion_h205_video_Ax.bin"
VIDEOELF2 = "companion_h205_video_Bx.bin"

SOC_FAMILY = "stih205"

MACHINE_ESSENTIAL_EXTRA_RDEPENDS += "\
    stlinux24-sh4-stxh205-fdma-firmware \
    evremote2 \
"

MACHINE_FEATURES += "hdmicec 4thgsh4"

CAN_USE_ENIGMA2_IN_FLASH = "1"
```

## conf/machine/include/hs.inc
```bitbake
require conf/machine/include/oem-sh4.inc
require conf/machine/include/sh4-ubi.inc

BOX_BRAND = "hs"

PREFERRED_PROVIDER_virtual/kernel = "linux-sh4-hs"

ROOTFS_FILE = "root.img"
KERNEL_FILE = "uImage"

AUDIOELF = "audio_7111.elf"
VIDEOELF = "video_7111.elf"

SOC_FAMILY = "sti7111"

MACHINE_ESSENTIAL_EXTRA_RDEPENDS += "\
	stlinux24-sh4-stx7111-fdma-firmware \
	stlinux24-sh4-stmfb-firmware-stx7111 \
	evremote2 \
	flash-tools \
	fortis-eeprom \
	fp-control \
	"

MACHINE_FEATURES += "hdmicec ci"
```

## conf/machine/include/ipbox.inc
```bitbake
require conf/machine/include/oem-sh4.inc
require conf/machine/include/normal-sh4-image.inc
require conf/machine/include/sh4-jffs2.inc

BOX_BRAND = "ipbox"

STXNUMBER = "stx7109"

ROOTFS_FILE = "root.img"
KERNEL_FILE = "uImage"

IMAGE_FSTYPES = "tar.gz"

AUDIOELF = "audio_7100.elf"
VIDEOELF = "video_7109.elf"

SOC_FAMILY = "sti7109"

MACHINE_ESSENTIAL_EXTRA_RDEPENDS += "\
	eeprom-${BOX_BRAND} \
	kernel-module-zram \
	stlinux24-sh4-stx7109-fdma-firmware \
	stlirc \
	"

MACHINE_FEATURES += "ci SCART"

CAN_USE_ENIGMA2_IN_FLASH = "0"

RCNAME = "cuberevo_uni"
```

## conf/machine/include/ird-sh4-image.inc
```bitbake
do_image_jffs2[depends] += "fup-native:do_populate_sysroot"

do_image_ubi[depends] += "fup-native:do_populate_sysroot"

IMAGE_CMD_jffs2_append = "\
    ; \
    while [ ! -s ${IMGDEPLOYDIR}/${IMAGE_NAME}${IMAGE_NAME_SUFFIX}.jffs2 ]; do sleep 1; done ; \
    cp ${IMGDEPLOYDIR}/${IMAGE_NAME}${IMAGE_NAME_SUFFIX}.jffs2 ${DEPLOY_DIR_IMAGE}/${IMAGE_NAME}${IMAGE_NAME_SUFFIX}.jffs2; \
    mkdir -p ${DEPLOY_DIR_IMAGE}/${IMAGEDIR}; \
    while [ ! -s ${DEPLOY_DIR_IMAGE}/${IMAGE_NAME}${IMAGE_NAME_SUFFIX}.jffs2 ]; do sleep 1; done ; \
    mv ${DEPLOY_DIR_IMAGE}/${IMAGE_NAME}${IMAGE_NAME_SUFFIX}.jffs2 ${DEPLOY_DIR_IMAGE}/${IMAGEDIR}/${ROOTFS_FILE}; \
    cp ${DEPLOY_DIR_IMAGE}/uImage ${DEPLOY_DIR_IMAGE}/${IMAGEDIR}/${KERNEL_FILE}; \
    rm -f ${DEPLOY_DIR_IMAGE}/*.zip; \
    rm -f ${DEPLOY_DIR_IMAGE}/*.ird; \
    cd ${DEPLOY_DIR_IMAGE}; \
    fup -ce ${IMAGEDIR}/${IMAGE_NAME}-R${RESELLERID}.ird -r ${IMAGEDIR}/${ROOTFS_FILE} -k ${IMAGEDIR}/${KERNEL_FILE}; \
    fup -r ${IMAGEDIR}/${IMAGE_NAME}-R${RESELLERID}.ird ${RESELLERID}; \
    zip ${IMAGE_NAME}_ird.zip ${IMAGEDIR}/${IMAGE_NAME}-R${RESELLERID}.ird; \
    rm -f ${IMAGEDIR}/*.ird; \
    zip ${IMAGE_NAME}_usb.zip ${IMAGEDIR}/*; \
    rm -f ${DEPLOY_DIR_IMAGE}/*.jffs2; \
    rm -f ${DEPLOY_DIR_IMAGE}/*.manifest; \
    rm -rf ${IMAGEDIR}; \
    "

IMAGE_CMD_ubi_append = "\
    while [ ! -s ${IMGDEPLOYDIR}/${IMAGE_NAME}${IMAGE_NAME_SUFFIX}.ubi ]; do sleep 1; done ; \
    cp ${IMGDEPLOYDIR}/${IMAGE_NAME}${IMAGE_NAME_SUFFIX}.ubi ${DEPLOY_DIR_IMAGE}/${IMAGE_NAME}${IMAGE_NAME_SUFFIX}.ubi; \
    mkdir -p ${DEPLOY_DIR_IMAGE}/${IMAGEDIR}; \
    while [ ! -s ${DEPLOY_DIR_IMAGE}/${IMAGE_NAME}${IMAGE_NAME_SUFFIX}.ubi ]; do sleep 1; done ; \
    mv ${DEPLOY_DIR_IMAGE}/${IMAGE_NAME}${IMAGE_NAME_SUFFIX}.ubi ${DEPLOY_DIR_IMAGE}/${IMAGEDIR}/${ROOTFS_FILE}; \
    cp ${DEPLOY_DIR_IMAGE}/uImage ${DEPLOY_DIR_IMAGE}/${IMAGEDIR}/${KERNEL_FILE}; \
    rm -f ${DEPLOY_DIR_IMAGE}/*.zip; \
    rm -f ${DEPLOY_DIR_IMAGE}/*.ird; \
    cd ${DEPLOY_DIR_IMAGE}; \
    fup -ce ${IMAGEDIR}/${IMAGE_NAME}-R${RESELLERID}.ird -r ${IMAGEDIR}/${ROOTFS_FILE} -k ${IMAGEDIR}/${KERNEL_FILE}; \
    fup -r ${IMAGEDIR}/${IMAGE_NAME}-R${RESELLERID}.ird ${RESELLERID}; \
    zip ${IMAGE_NAME}_ird.zip ${IMAGEDIR}/${IMAGE_NAME}-R${RESELLERID}.ird; \
    rm -f ${IMAGEDIR}/*.ird; \
    zip ${IMAGE_NAME}_usb.zip ${IMAGEDIR}/*; \
    rm -f ${DEPLOY_DIR_IMAGE}/*.ubi; \
    rm -f ${DEPLOY_DIR_IMAGE}/*.manifest; \
    rm -rf ${IMAGEDIR}; \
"
```

## conf/machine/include/kathrein.inc
```bitbake
require conf/machine/include/oem-sh4.inc
require conf/machine/include/normal-sh4-image.inc
require conf/machine/include/sh4-jffs2.inc

BOX_BRAND = "kathrein"

PREFERRED_PROVIDER_virtual/kernel = "linux-sh4-${MACHINE}"

ROOTFS_FILE = "root.img"
KERNEL_FILE = "uImage"

IMAGE_FSTYPES = "tar.gz"

MACHINE_ESSENTIAL_EXTRA_RDEPENDS += "\
	evremote2 \
	fp-control \
	"

MACHINE_FEATURES += "RCA YUV SCAR"

RCNAME = "ufs912"
```

## conf/machine/include/nbox.inc
```bitbake
require conf/machine/include/oem-sh4.inc
require conf/machine/include/normal-sh4-image.inc
require conf/machine/include/sh4-jffs2.inc

BOX_BRAND = "nbox"

ROOTFS_FILE = "root.img"
KERNEL_FILE = "uImage"

IMAGE_FSTYPES += "tar.gz"

MACHINE_FEATURES += "hdmicec ci twintuner smallflash YUV"

MACHINE_ESSENTIAL_EXTRA_RDEPENDS += "\
	stlirc \
	evremote2 \
	firmware-sh4 \
	enigma2-plugin-extensions-adbvfd \
	"

CAN_USE_ENIGMA2_IN_FLASH = "1"
```

## conf/machine/include/normal-sh4-image.inc
```bitbake
IMAGE_CMD_jffs2_append = " \
	; \
	while [ ! -s ${IMGDEPLOYDIR}/${IMAGE_NAME}${IMAGE_NAME_SUFFIX}.jffs2 ]; do sleep 1; done ; \
	cp ${IMGDEPLOYDIR}/${IMAGE_NAME}${IMAGE_NAME_SUFFIX}.jffs2 ${DEPLOY_DIR_IMAGE}/${IMAGE_NAME}${IMAGE_NAME_SUFFIX}.jffs2; \
	mkdir -p ${DEPLOY_DIR_IMAGE}/${IMAGEDIR}; \
	while [ ! -s ${DEPLOY_DIR_IMAGE}/${IMAGE_NAME}${IMAGE_NAME_SUFFIX}.jffs2 ]; do sleep 1; done ; \
	mv ${DEPLOY_DIR_IMAGE}/${IMAGE_NAME}${IMAGE_NAME_SUFFIX}.jffs2 ${DEPLOY_DIR_IMAGE}/${IMAGEDIR}/${ROOTFS_FILE}; \
	cp ${DEPLOY_DIR_IMAGE}/uImage ${DEPLOY_DIR_IMAGE}/${IMAGEDIR}/${KERNEL_FILE}; \
	rm -f ${DEPLOY_DIR_IMAGE}/*.zip; \
	cd ${DEPLOY_DIR_IMAGE}; \
	zip ${IMAGE_NAME}_usb.zip ${IMAGEDIR}/*; \
	rm -f ${DEPLOY_DIR_IMAGE}/*.jffs2; \
	rm -rf ${IMAGEDIR}; \
	"

IMAGE_CMD_ubi_append = " \
	while [ ! -s ${IMGDEPLOYDIR}/${IMAGE_NAME}${IMAGE_NAME_SUFFIX}.ubi ]; do sleep 1; done ; \
	cp ${IMGDEPLOYDIR}/${IMAGE_NAME}${IMAGE_NAME_SUFFIX}.ubi ${DEPLOY_DIR_IMAGE}/${IMAGE_NAME}${IMAGE_NAME_SUFFIX}.ubi; \
	mkdir -p ${DEPLOY_DIR_IMAGE}/${IMAGEDIR}; \
	while [ ! -s ${DEPLOY_DIR_IMAGE}/${IMAGE_NAME}${IMAGE_NAME_SUFFIX}.ubi ]; do sleep 1; done ; \
	mv ${DEPLOY_DIR_IMAGE}/${IMAGE_NAME}${IMAGE_NAME_SUFFIX}.ubi ${DEPLOY_DIR_IMAGE}/${IMAGEDIR}/${ROOTFS_FILE}; \
	cp ${DEPLOY_DIR_IMAGE}/uImage ${DEPLOY_DIR_IMAGE}/${IMAGEDIR}/${KERNEL_FILE}; \
	rm -f ${DEPLOY_DIR_IMAGE}/*.zip; \
	cd ${DEPLOY_DIR_IMAGE}; \
	zip ${IMAGE_NAME}_usb.zip ${IMAGEDIR}/*; \
	rm -f ${DEPLOY_DIR_IMAGE}/*.ubi; \
	rm -f ${DEPLOY_DIR_IMAGE}/*.ubifs; \
	rm -rf ${IMAGEDIR}; \
	"
```

## conf/machine/include/oem-fulan.inc
```bitbake
# We know about rtc
include conf/machine/include/build-extras.inc

BRAND_OEM = "fulan"
MACHINE_NAME = "${@bb.utils.contains('MACHINE', 'spark7162', 'SPARK TRIPLEX', 'SPARK 990 LX', d)}"
MACHINE_BRAND = "GOLDEN MEDIA"
IMAGEDIR ?= "enigma2"
MTD_KERNEL = "mtd5"
MTD_ROOTFS = "mtd6"
KERNEL_FILE = "uImage"
ROOTFS_FILE = "e2jffs2.img"

MACHINE_KERNEL_PR = "r1"
KERNEL_MODULE_PACKAGE_SUFFIX = ""

TARGET_ARCH = "sh4"
DEFAULTTUNE = "sh4"

GCCVERSION = "4.9.4"

GLIBCVERSION = "2.23"
OLDEST_KERNEL = "2.6.32"

PREFERRED_PROVIDER_virtual/kernel = "linux-fulan"
PREFERRED_VERSION_linux-libc-headers = "2.6.32"
PREFERRED_VERSION_directfb = "1.7.7"
PREFERRED_VERSION_rt8812au = "4.3.14"
PREFERRED_VERSION_samba = "3.%"

PREFERRED_PROVIDER_virtual/egl = "libstgles"
PREFERRED_PROVIDER_virtual/libgles1 = "libstgles"

SERIAL_CONSOLE = "115200 ttyAS0"

DVBPROVIDER = "kernel"

OPENPLI_FEATURES += "usbconsole ci"
MACHINE_FEATURES += "ext2 serial wlan dvb-c hdmicec 3dtv switchoff textlcd fulan singlecore directfb sh4booster legacykernel"
DISTRO_FEATURES_remove = "x11 wayland"

KERNEL_IMAGETYPE = "uImage"
#KERNEL_OUTPUT = "${KERNEL_IMAGETYPE}"


JFFS2_ERASEBLOCK = "0x20000"
JFFS2_ENDIANNESS = "${@base_conditional('SITEINFO_ENDIANNESS', 'le', '--little-endian', '--big-endian', d)}"
EXTRA_IMAGECMD_jffs2 = "--pad ${JFFS2_ENDIANNESS} --eraseblock=${JFFS2_ERASEBLOCK} --no-cleanmarkers"
MKUBIFS_ARGS = "--pad ${JFFS2_ENDIANNESS} --eraseblock=${JFFS2_ERASEBLOCK} --no-cleanmarkers"
DVBMEDIASINK_CONFIG = "--with-machine=${MACHINE} --with-wma --with-wmv --with-pcm --with-dtsdownmix --with-eac3"

IMAGE_FSTYPES ?= "jffs2"

# enable this for debug
IMAGE_FSTYPES += "tar.gz"
IMAGE_FSTYPES += "spark71xxusbimg"
# INHERIT += "usb_image-spark71xx"

IMAGE_CLASSES += "usb_image-spark71xx"
INITRAMFS_FSTYPES =  "ext2.gz sparkupdt"

IMAGE_CMD_jffs2_prepend = " \
    rm -rf ${IMAGE_ROOTFS}/tmp/*; \
    "

IMAGE_CMD_jffs2_append = " ; \
    cp ${IMGDEPLOYDIR}/${IMAGE_NAME}.rootfs.jffs2 ${DEPLOY_DIR_IMAGE}/${IMAGE_NAME}.rootfs.jffs2; \
    mkdir -p ${DEPLOY_DIR_IMAGE}/${IMAGEDIR}; \
    mv ${DEPLOY_DIR_IMAGE}/${IMAGE_NAME}.rootfs.jffs2 ${DEPLOY_DIR_IMAGE}/${IMAGEDIR}/${ROOTFS_FILE}; \
    cp ${DEPLOY_DIR_IMAGE}/uImage ${DEPLOY_DIR_IMAGE}/${IMAGEDIR}/${KERNEL_FILE}; \
    cd ${DEPLOY_DIR_IMAGE}; \
    zip ${IMAGE_NAME}_usb.zip ${IMAGEDIR}/*; \
    rm -f ${DEPLOY_DIR_IMAGE}/*.jffs2; \
    rm -f ${DEPLOY_DIR_IMAGE}/*.manifest; \
    rm -f ${DEPLOY_DIR_IMAGE}/.jffs2; \
    rm -f ${DEPLOY_DIR_IMAGE}/.manifest; \
    rm -rf ${IMAGEDIR}; \
    "

# Add uImage in tar image boot directory
IMAGE_CMD_tar_prepend = " \
    cp ${DEPLOY_DIR_IMAGE}/uImage ${IMAGE_ROOTFS}/boot/${KERNEL_FILE}; \
    "
	
MACHINE_ESSENTIAL_EXTRA_RDEPENDS += " \
    stlinux24-sh4-stx7111-fdma-firmware \
    stslave-fw \
    ustslave \
    stfbcontrol \
    fp-control \
    stlirc \
    stinit \
    fulan-dvb-modules-${MACHINE} \
    flash-tools \
    mountspark \
    mtd-utils-jffs2 \
    libeplayer3 \
    "

MACHINE_EXTRA_RRECOMMENDS = " \
    firmware-carl9170 \
    firmware-htc7010 \
    firmware-htc9271 \
    firmware-rt2870 \
    firmware-rt73 \
    firmware-rtl8712u \
    firmware-zd1211 \
    firmware-rtl8192cu \
    firmware-rt3070 \
    firmware-mt7601u \
    firmware-rtl8188eu \
    firmware-rtl8xxxu \
    \
    gstreamer1.0-plugin-dvbmediasink \
    \
    kernel-module-rtl8187 \
    kernel-module-zd1211rw \
    kernel-module-ar9170usb \
    kernel-module-rt2500usb \
    kernel-module-rt73usb \
    kernel-module-rt2800usb \
    kernel-module-ath \
    kernel-module-rt2x00usb \
    kernel-module-rt2x00lib \
    kernel-module-mt7601usta \
    kernel-module-rt2870sta \
    kernel-module-rt3070sta \
    kernel-module-rt5370sta \
    kernel-module-8188eu \
    kernel-module-8192cu \
    kernel-module-8712u \
    mt7610u \
    rt8723a \
    rt8723bs \
    rt8812au \
    rtl8192eu \
    ntfs-3g \
    rt7777-sh4 \
    "

EXTRA_IMAGEDEPENDS += " \
    libpcre \
    libstgles \
    directfb-stgfx2 \
    aio-grab \
    "

MACHINE_EXTRA_RDEPENDS = "\
    libpcre \
    aio-grab \
    "

include conf/machine/include/autoload-filesystems.inc
require conf/machine/include/tune-sh4.inc
require conf/machine/include/soc-family.inc
```
