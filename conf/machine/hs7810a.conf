## conf/machine/include/oem-sh4.inc
```bitbake
# We know about rtc
MACHINE_FEATURES_BACKFILL_CONSIDERED += "rtc"

require conf/machine/include/libeplayer-sh4-condition.inc

IMAGEDIR = "enigma2"

KERNEL_MODULE_PACKAGE_SUFFIX = ""

TARGET_ARCH = "sh4"
DEFAULTTUNE = "sh4"

GCCVERSION = "4.9.4"
GLIBCVERSION = "2.25"

HOSTTOOLS_NONFATAL += "whoami"

OLDEST_KERNEL = "2.6.32"
PREFERRED_VERSION_kernel-module-extrawlan-rt8812au = "4.3.14"
PREFERRED_VERSION_directfb = "1.7.7"
PREFERRED_PROVIDER_lirc = "stlirc"
PREFERRED_PROVIDER_virtual/egl = "libstgles"
PREFERRED_PROVIDER_virtual/libgles1 = "libstgles"
PREFERRED_PROVIDER_virtual/enigma2-mediaservice = "enigma2-plugin-systemplugins-servicemp3epl"

SERIAL_CONSOLE = "115200 ttyAS0"

DVBPROVIDER = "kernel"

MACHINE_FEATURES += "alsa ext2 usbhost serial dvb-c switchoff textlcd usbconsole sh4stb ${MACHINE} HDMI"

DISTRO_FEATURES_append = " libsigc2"

KERNEL_IMAGETYPE = "uImage"

DVBMEDIASINK_CONFIG = "--with-wma --with-wmv --with-pcm --with-dtsdownmix --with-eac3"

IMAGE_CLASSES += "usb_image-sh4"

INITRAMFS_FSTYPES =  "ext2.gz sh4updt"

# Add uImage in tar image boot directory
IMAGE_CMD_tar_prepend = "\
    cp ${DEPLOY_DIR_IMAGE}/uImage ${IMAGE_ROOTFS}/boot/${KERNEL_FILE}; \
    "
	
MACHINE_ESSENTIAL_EXTRA_RDEPENDS += "\
	stslave-fw \
	ustslave \
	stfbcontrol \
	devinit \
	sh4-dvb-modules \
	wait4button \
	"

# Adding for sh4 receivers the most popular Wi-Fi chips for usb devices
MACHINE_ESSENTIAL_EXTRA_RRECOMMENDS += "\
	${@bb.utils.contains_any("MACHINE_FEATURES", "smallflash middleflash", "", " \
	kernel-module-extrawlan-mt7601u \
	firmware-mt7601u \
	kernel-module-extrawlan-rt3070 \
	firmware-rt2870 \
	kernel-module-extrawlan-rtl8188eu \
	firmware-rtl8188eu \
	kernel-module-extrawlan-rtl8192cu \
	firmware-rtl8192cu \
	kernel-module-extrawlan-rtl8192eu \
	firmware-rtl8192eu", d)} \
	"

EXTRA_IMAGEDEPENDS += "\
	libpcre \
	"

MACHINE_EXTRA_RDEPENDS += "\
	libpcre \
	"


require conf/machine/include/tune-sh4.inc
require conf/machine/include/soc-family.inc

EXTRA_OECONF_append_pn-enigma2 = " --with-sh4stb"
```

## conf/machine/include/sh4-ubi.inc
```bitbake
IMAGE_FSTYPES ?= "ubi"

MKUBIFS_ARGS = "${@bb.utils.contains("MACHINE_FEATURES", "4thgsh4", "-m 2048 -e 129024 -c 1456 -x zlib", "-m 2048 -e 129024 -c 1024 -x zlib", d)}"
UBINIZE_ARGS = "-m 2048 -p 128KiB -s 512"

EXTRA_IMAGECMD_COMPAT = " --eraseblock=0x20000 -n -l "

MACHINE_ESSENTIAL_EXTRA_RDEPENDS += "\
	mtd-utils-ubifs \
	"

IMAGE_CMD_ubi_prepend = " \
    rm -rf ${IMAGE_ROOTFS}/tmp/*; \
    "
```

## conf/machine/include/spark.inc
```bitbake
require conf/machine/include/oem-sh4.inc
require conf/machine/include/normal-sh4-image.inc
require conf/machine/include/sh4-jffs2.inc

BOX_BRAND = "fulan"

MTD_KERNEL = "mtd5"
MTD_ROOTFS = "mtd6"

ROOTFS_FILE = "e2jffs2.img"
KERNEL_FILE = "uImage"

IMAGE_FSTYPES += "tar.gz"

MACHINE_ESSENTIAL_EXTRA_RDEPENDS += "\
	flash-tools \
	fp-control \
	kernel-module-zram \
	mount-sh4 \
	stlirc \
	"

MACHINE_FEATURES += "hdmicec ci SCART RCA"

CAN_USE_ENIGMA2_IN_FLASH = "1"

RCTYPE = "10"

IMAGE_CLASSES += "usb_image-sh4"

INITRAMFS_FSTYPES =  "ext2.gz sh4updt"
```

## conf/machine/include/viphl.inc
```bitbake
require conf/machine/include/oem-sh4.inc
require conf/machine/include/wifi-sh4.inc

PREFERRED_PROVIDER_virtual/kernel = "linux-sh4-viphl"

ROOTFS_FILE = "root.img"
KERNEL_FILE = "uImage"

IMAGE_FSTYPES += "tar.gz"

AUDIOELF = "audio_7100.elf"
VIDEOELF = "video_7109.elf"

SOC_FAMILY = "sti7109"

MACHINE_ESSENTIAL_EXTRA_RDEPENDS += "\
    stlirc \
    stlinux24-sh4-stx7109-fdma-firmware \
"

MACHINE_FEATURES += "modviphl"
```

## conf/machine/ipbox55.conf
```bitbake
require conf/machine/include/ipbox.inc

MACHINE_FEATURES += "ipbox55"

#What we need
#extra/frontcontroller/ipbox55/front.ko /lib/modules/
```

## conf/machine/ipbox9900.conf
```bitbake
require conf/machine/include/ipbox.inc

MACHINE_FEATURES += "twintuner fan ipbox9900"
```

## conf/machine/octagon1008.conf
```bitbake
require conf/machine/include/oem-sh4.inc
require conf/machine/include/normal-sh4-image.inc
require conf/machine/include/sh4-jffs2.inc

BOX_BRAND = "octagon"

STXNUMBER = "stx7109"

ROOTFS_FILE = "root.img"
KERNEL_FILE = "uImage"

IMAGE_FSTYPES = "tar.gz"

MACHINE_FEATURES += "ci RCA YUV resellerid"

AUDIOELF = "audio_7100.elf"
VIDEOELF = "video_7109.elf"

SOC_FAMILY = "sti7109"

DVB1FIRMWARE = "dvb-fe-avl2108.fw"
DVB2FIRMWARE = "dvb-fe-stv6306.fw"

MACHINE_ESSENTIAL_EXTRA_RDEPENDS += "\
	firmware-sh4 \
	fp-control \
	kernel-module-zram \
	stlinux24-sh4-stx7109-fdma-firmware \
	"

CAN_USE_ENIGMA2_IN_FLASH = "0"

RESELLERID = "20220302"

RCNAME = "hs9510"

FRIENDLY_FAMILY = "hs9510"
```

## conf/machine/opt9600.conf
```bitbake
require conf/machine/include/crenova.inc

AUDIOELF = "audio_7100.elf"
VIDEOELF = "video_7109.elf"

SOC_FAMILY = "sti7109"

DVB1FIRMWARE = "dvb-fe-avl2108.fw"
DVB2FIRMWARE = "dvb-fe-stv6306.fw"

MACHINE_ESSENTIAL_EXTRA_RDEPENDS += "\
	firmware-sh4 \
	stlinux24-sh4-stx7109-fdma-firmware \
	"

MACHINE_FEATURES += "SCART YUV"

STXNUMBER = "stx7109"
```

## conf/machine/opt9600prima.conf
```bitbake
require conf/machine/include/crenova.inc

AUDIOELF = "audio_7105.elf"
VIDEOELF = "video_7105.elf"

SOC_FAMILY = "sti7105"

DVB1FIRMWARE = "dvb-fe-avl2108.fw"
DVB2FIRMWARE = "component_7105_pdk7105.fw"

MACHINE_ESSENTIAL_EXTRA_RDEPENDS += "\
	stlinux24-sh4-stmfb-firmware-stx7105 \
	stlinux24-sh4-stx7105-fdma-firmware \
	"

STXNUMBER = "stx7105"
```
